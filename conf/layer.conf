## conf/layer.conf
```bitbake
# We have a conf and classes directory, add to BBPATH
BBPATH .= ":${LAYERDIR}"

# We have recipes-* directories, add to BBFILES
BBFILES += "${LAYERDIR}/recipes-*/*/*.bb \
            ${LAYERDIR}/recipes-*/*/*.bbappend"

BBFILE_COLLECTIONS += "meta-iotfablab"
BBFILE_PATTERN_meta-iotfablab = "^${LAYERDIR}/"
BBFILE_PRIORITY_meta-iotfablab = "6"

LAYERDEPENDS_meta-iotfablab = "core"
LAYERSERIES_COMPAT_meta-iotfablab = "warrior"
```
